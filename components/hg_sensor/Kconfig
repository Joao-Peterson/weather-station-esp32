## components/hg_sensor/Kconfig
```kconfig
menu "HG sensor config (DHT22/AM2302)"

config HUMIDITY_READ_COOLDOWN_MS
	int "Humidity cooldown between calls of hg_read() in milliseconds"
	default 1000
	range 10 900000
	help 
		AM2302 digital humidity and temperature sensor cooldown between calls of hg_read() in milliseconds, if exceeded, call will return if code 'hg_err_sensor_on_cooldown_time'

endmenu
```

## components/rain_gauge/Kconfig
```kconfig
menu "Rain gauge sensor"

config RAIN_GAUGE_RATIO    
	int "Ratio of counts to mm of precipitation"
	default 1000000
	help
		Rain gauge ratio between measured counts and actual precipitation. Given as 10^6.

endmenu
```

## components/solar_sensor/Kconfig
```kconfig
menu "Solar incidency sensor"

config SOLAR_CELL_ADC_UNIT
	int "ADC unit index"
	default 0
	range 0 1
	help 
		ADC unit. From the enum: ADC_UNIT_1 = 0, ADC_UNIT_2 = 1

config SOLAR_CELL_ADC_BITWIDTH
	int "ADC unit bitwidth (resolution)"
	default 12
	range 0 13
	help 
		ADC bitwidth. From the enum: ADC_BITWIDTH_DEFAULT = 0, ADC_BITWIDTH_9  = 9, ADC_BITWIDTH_10 = 10, ADC_BITWIDTH_11 = 11, ADC_BITWIDTH_12 = 12, ADC_BITWIDTH_13 = 13. BEWARE OF MAX THE BITWIDTH FOR YOUR ESPMODEL! 

config SOLAR_CELL_ADC_ATTEN
	int "ADC unit attenuation"
	default 3
	range 0 3
	help 
		ADC attenuation. From the enum: ADC_ATTEN_DB_0 = 0, ADC_ATTEN_DB_2_5 = 1, ADC_ATTEN_DB_6 = 2, ADC_ATTEN_DB_11 = 3

config SOLAR_CELL_ADC_INCIDENCY_A
	int "Solar incidency angular coefficient"
	default 434782
	help 
		Angular coefficient for the linear computation of solar incidency from read voltage. Given as 10^6.
		
config SOLAR_CELL_ADC_INCIDENCY_B
	int "Solar incidency linear coefficient"
	default 0
	help 
		Linear coefficient for the linear computation of solar incidency from read voltage. Given as 10^6.

config SOLAR_CELL_ADC_USE_CALI
	bool "Use ADC calibration driver"
	default y
	help 
		If true use calibration driver for converting raw value to mV, otherwise use default conversion

endmenu
```

## components/temp_sensor/Kconfig
```kconfig
menu "Temperature sensor (LM35)"

config TEMP_ADC_BITWIDTH
	int "ADC unit bitwidth (resolution)"
	default 12
	range 0 13
	help 
		ADC bitwidth. From the enum: ADC_BITWIDTH_DEFAULT = 0, ADC_BITWIDTH_9  = 9, ADC_BITWIDTH_10 = 10, ADC_BITWIDTH_11 = 11, ADC_BITWIDTH_12 = 12, ADC_BITWIDTH_13 = 13. BEWARE OF MAX THE BITWIDTH FOR YOUR ESPMODEL! 

config TEMP_ADC_ATTEN
	int "ADC unit attenuation"
	default 3
	range 0 3
	help 
		ADC attenuation. From the enum: ADC_ATTEN_DB_0 = 0, ADC_ATTEN_DB_2_5 = 1, ADC_ATTEN_DB_6 = 2, ADC_ATTEN_DB_11 = 3

config TEMP_CORR_A
	int "Temperature correction angular coefficient"
	default 100000000
	help 
		Angular coefficient for the linear correction of the read temperature. Given as 10^6.
		
config TEMP_CORR_B
	int "Temperature correction linear coefficient"
	default 0
	help 
		Linear coefficient for the linear correction of the read temperature. Given as 10^6.

config TEMP_ADC_USE_CALI
	bool "Use ADC calibration driver"
	default y
	help 
		If true use calibration driver for converting raw value to mV, otherwise use default conversion

endmenu
```

## main/Kconfig.projbuild
```kconfig
menu "Weather station config"

config HOSTNAME
    string "Hostname for the esp. Use less then 25 chars before the %s. The %s is where the serial number will be inserted (maybe truncated)"
    default "espWS %s"
    help
        Hostname for the esp. The %s is where the serial number will be inserted (maybe truncated)

config GPIO_RAIN_GAUGE
    int "Rain gauge digital input"
    range 1 39
    default 23
    help
        Rain gauge 44E 402 Digital hall sensor input.

config GPIO_HUMIDITY
    int "AM2302 digital humidity and temperature sensor input"
    range 1 39
    default 22
    help
        AM2302 digital humidity and temperature sensor input.

config ANALOG_SENSORS_ADC_UNIT
	int "Analog sensor ADC unit index"
	default 0
	range 0 1
	help 
		ADC unit to be used on the analog sensors. From the enum: ADC_UNIT_1 = 0, ADC_UNIT_2 = 1

config TEMP_SENSOR_ADC_CHANNEL
    int "ADC channel for the temperature sensor (LM35)"
    default 0
    range 0 9
    help 
        ADC channel. From the enum: ADC_CHANNEL_0 = 0, ADC_CHANNEL_1 = 1, and so on ...

config SOLAR_CELL_ADC_CHANNEL
    int "ADC channel for the solar cell incidency sensor"
    default 7
    range 0 9
    help 
        ADC channel. From the enum: ADC_CHANNEL_0 = 0, ADC_CHANNEL_1 = 1, and so on ...

endmenu
```
